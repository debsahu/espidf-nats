## example/sdkconfig.defaults
```kconfig
# ESP-IDF Configuration defaults for NATS test app

# WiFi Configuration
CONFIG_ESP_WIFI_SSID=""
CONFIG_ESP_WIFI_PASSWORD=""

# Main task stack size
CONFIG_ESP_MAIN_TASK_STACK_SIZE=8192

# FreeRTOS
CONFIG_FREERTOS_HZ=1000
CONFIG_FREERTOS_UNICORE=n

# LWIP
CONFIG_LWIP_MAX_SOCKETS=16

# Component config
CONFIG_PARTITION_TABLE_SINGLE_APP_LARGE=y

# WebSocket client (required for WebSocket transport tests)
CONFIG_ESP_WEBSOCKET_CLIENT_ENABLE=y

# TLS/SSL (required for wss:// support)
CONFIG_ESP_TLS_USING_MBEDTLS=y
CONFIG_MBEDTLS_SSL_MAX_CONTENT_LEN=16384
CONFIG_MBEDTLS_CERTIFICATE_BUNDLE=y
CONFIG_MBEDTLS_CERTIFICATE_BUNDLE_DEFAULT_FULL=y
```
